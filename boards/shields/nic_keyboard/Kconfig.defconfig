## boards/shields/nic_keyboard/Kconfig.defconfig
```kconfig
# Copyright (c) 2022 The ZMK Contributors
# SPDX-License-Identifier: MIT

if NIC_KEYBOARD_LEFT

config ZMK_KEYBOARD_NAME
    default "NIC Keyboard"

config ZMK_SPLIT_ROLE_CENTRAL
    default y

endif # SHIELD_SPLITKB_AURORA_SWEEP_LEFT

if NIC_KEYBOARD_LEFT || NIC_KEYBOARD_RIGHT

config ZMK_SPLIT
    default y

config ZMK_RGB_UNDERGLOW
    select WS2812_STRIP
    select SPI

config ZMK_DISPLAY

if ZMK_DISPLAY

config SSD1306
    default y

config I2C
    default y

endif # ZMK_DISPLAY

if LVGL

config LV_Z_VDB_SIZE
    default 64

config LV_DPI_DEF
    default 148

config LV_Z_BITS_PER_PIXEL
    default 1

choice LV_COLOR_DEPTH
    default LV_COLOR_DEPTH_1
endchoice

endif # LVGL

endif # NIC_KEYBOARD_LEFT || NIC_KEYBOARD_RIGHT
```

## boards/shields/nic_keyboard/Kconfig.shield
```kconfig
# Copyright (c) 2022 The ZMK Contributors
# SPDX-License-Identifier: MIT

config SHIELD_NIC_KEYBOARD_LEFT
    def_bool $(shields_list_contains,nic_keyboard_left)

config SHIELD_NIC_KEYBOARD_RIGHT
    def_bool $(shields_list_contains,nic_keyboard_right)
```
